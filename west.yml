## west.yml
```yaml
manifest:
  projects:
    - name: zephyr
      revision: 36f907e43ccedd28a93ee1ee33191f5d15c69925
      url: https://github.com/zephyrproject-rtos/zephyr
      west-commands: scripts/west-commands.yml
      import:
        name-allowlist:
          - cmsis
          - hal_espressif
          - hal_nordic
          - mbedtls
          - mcuboot
          - mcumgr
          - net-tools
          - segger
          - tinycbor
          - tinycrypt

    - name: qcbor
      revision: 17b5607b8c49b835d22dec3effa97b25c89267b3
      url: https://github.com/golioth/QCBOR.git
      path: modules/lib/qcbor

  self:
    path: modules/lib/golioth
    west-commands: scripts/west-commands.yml
```
